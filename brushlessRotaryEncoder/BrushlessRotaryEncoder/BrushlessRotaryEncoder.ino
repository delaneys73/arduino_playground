/*
 * Laser Printer Brushless Motor as Rotary Encoder 
 * DR-62312-012
 * 
 * The step patterns generated by the hall effect sensors are
 * 
 * When turning clockwise
 * 
 * 0,0,1 = 4
 * 0,0,0 = 0
 * 1,0,0 = 1
 * 1,1,0 = 3
 * 1,1,1 = 7
 * 0,1,1 = 6
 * 
 * When turning counter clockwise
 * 
 * 1,1,1 = 7
 * 1,0,1 = 5
 * 1,0,0 = 1
 * 0,0,0 = 0
 * 0,1,0 = 2
 * 0,1,1 = 6
*/
#define STEP 13
#define STEP_DIR 9
#define HALL_SENSE_1 6
#define HALL_SENSE_2 7
#define HALL_SENSE_3 8
#define INITIAL 255
#define DIR_NONE -1
#define DIR_CW 1
#define DIR_CCW 0
#define DEBUG 1

int a,b,c;

int last;
int curr;

int count = 0;

// the setup function runs once when you press reset or power the board
void setup() {
  // initialize digital pin LED_BUILTIN as an output.
  pinMode(HALL_SENSE_1, INPUT);
  pinMode(HALL_SENSE_2, INPUT);
  pinMode(HALL_SENSE_3, INPUT);
  pinMode(STEP, OUTPUT);
  pinMode(STEP_DIR, OUTPUT);
  if (DEBUG == 1) {
    Serial.begin(9600);
  }
  digitalWrite(STEP_DIR, LOW);
  digitalWrite(STEP, LOW);
  last = INITIAL;
}

int getDir(int curr) {
  int DIR = DIR_NONE;
  if (curr == 0) {
    DIR = last == 4 ? DIR_CW : DIR_CCW;
  }

  if (curr == 7) {
    DIR = last == 3 ? DIR_CW : DIR_CCW;
  }

  if (curr == 6) {
    DIR = last == 7 ? DIR_CW : DIR_CCW;
  }

  if (curr == 1) {
    DIR = last == 0 ? DIR_CW : DIR_CCW;
  }

  if (curr ==3 || curr == 4)
  {
    DIR = DIR_CW;
  }

  if (curr ==5 || curr == 2)
  {
    DIR = DIR_CCW;
  }

  return DIR;
}

int readPosition() {
  a = digitalRead(HALL_SENSE_1);   
  b = digitalRead(HALL_SENSE_2);   
  c = digitalRead(HALL_SENSE_3);   

  return (a * 1) + (b * 2) + (c *4);
}

void debugState(int dir) {
  if (dir == DIR_CW) {
    count = count +1;
  }
  if (dir == DIR_CCW) {
    count = count -1;
  }
  Serial.print(a);
  Serial.print(',');
  Serial.print(b);
  Serial.print(',');
  Serial.print(c);
  Serial.print(':');
  Serial.println(count);
}

void sendPulse() {
    digitalWrite(STEP, HIGH);
    delay(1);
    digitalWrite(STEP, LOW);    
}

void loop() {
  curr = readPosition();
  if (last != INITIAL) {
    if (last != curr) {
      int dir = getDir(curr);
      if (dir == DIR_CCW || dir ==DIR_CW) {
          digitalWrite(STEP_DIR, dir);
      }
      sendPulse();
      if (DEBUG == 1) {
        debugState(dir);
      }
    }
  }
  
  last = curr;
}
